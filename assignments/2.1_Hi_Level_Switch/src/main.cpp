/**
 * @author Yevhenii Vinokur @ 2026
 * @file    main.cpp
 * @brief TODO 2.2 Assignment
 */
#include <Arduino.h>

const int RELAY_CTRL_PIN = 2;  // Пін, який подає струм на котушку реле (керування)
const int RELAY_SENSE_PIN = 4; // Пін, який читає стан сухого контакту (через підтяжку INPUT_PULLUP)

// ==========================================
// ЗМІННІ ДЛЯ ПЕРЕРИВАННЯ 
// ==========================================
volatile uint32_t reactionTime = 0;  // Час "ФІНІШУ" (коли контакт фізично вдарився)
volatile bool eventCaptured = false; // Прапорець-замок. Стає true, коли ми спіймали перший удар (захист від брязкоту)

// ==========================================
// ЗМІННІ ЛОГІКИ ПРОГРАМИ
// ==========================================
uint32_t triggerTime = 0;         // Час "СТАРТУ" (коли ми подали сигнал на реле)
bool relayState = false;          // Поточний режим, який ми хочемо встановити: false = OFF, true = ON
bool resultPrinted = true;        // Прапорець, щоб вивести результат вимірювання у Serial лише 1 раз

int cycleCount = 0;               // Лічильник пройдених циклів (один цикл = увімкнення + вимкнення)
const int MAX_CYCLES = 10;        // Скільки циклів вимагає завдання (10)

uint32_t totalTimeOn = 0;         // Копилка для сум часу увімкнення (щоб потім знайти середнє)
uint32_t totalTimeOff = 0;        // Копилка для сум часу вимкнення

uint32_t lastToggleTime = 0;      // Час, коли ми востаннє клацали реле (для нашого метронома)
const uint32_t TOGGLE_INTERVAL = 500; // Інтервал метронома — 500 мс (пів секунди)


// ==========================================
// ПЕРЕРИВАННЯ (ISR - Interrupt Service Routine)
// IRAM_ATTR гарантує, що функція працює з найшвидшої пам'яті контролера
// ==========================================
void IRAM_ATTR relayISR() {
    // Якщо ми ще не ловили сигнал у цьому циклі...
    if (!eventCaptured) {
        reactionTime = micros(); // 1. Фіксуємо точний час фінішу в мікросекундах!
        eventCaptured = true;    // 2. Закриваємо замок. Всі наступні мікро-відскоки (дребезг) будуть проігноровані
    }
}


// ==========================================
// НАЛАШТУВАННЯ (Виконується 1 раз)
// ==========================================
void setup() {
    Serial.begin(115200); // Запускаємо зв'язок з комп'ютером
    
    // Налаштовуємо пін керування на ВИХІД і відразу вимикаємо реле
    pinMode(RELAY_CTRL_PIN, OUTPUT);
    digitalWrite(RELAY_CTRL_PIN, LOW);
    
    // Налаштовуємо пін зчитування на ВХІД із підтяжкою до 3.3 Вольт
    // Коли реле розімкнуте - на піні буде HIGH. Коли замкнене - LOW.
    pinMode(RELAY_SENSE_PIN, INPUT_PULLUP);
    
    // Вішаємо переривання. 
    // CHANGE означає, що переривання спрацює на БУДЬ-ЯКУ зміну (і замикання, і розмикання)
    attachInterrupt(digitalPinToInterrupt(RELAY_SENSE_PIN), relayISR, CHANGE);
    
    delay(2000); // Чекаємо 2 секунди, щоб ви встигли відкрити Serial Monitor
    Serial.println("--- Старт вимірювань (10 циклів) ---");
}


// ==========================================
// ОСНОВНИЙ ЦИКЛ (Суперцикл - крутиться мільйони разів на секунду)
// ==========================================
void loop() {
    // ---------------------------------------------------------
    // БЛОК 1: ЗУПИНКА ПІСЛЯ 10 ЦИКЛІВ
    // ---------------------------------------------------------
    if (cycleCount >= MAX_CYCLES) {
        static bool finished = false; // Ця змінна живе між циклами loop
        if (!finished) {
            // Рахуємо та виводимо середнє значення (Загальна сума / 10)
            Serial.println("\n====== ПІДСУМКИ ======");
            Serial.printf("Середній час ON:  %lu мкс\n", totalTimeOn / MAX_CYCLES);
            Serial.printf("Середній час OFF: %lu мкс\n", totalTimeOff / MAX_CYCLES);
            Serial.println("======================");
            finished = true; // Забороняємо друкувати підсумки повторно
        }
        return; // МИТТЄВИЙ ВИХІД. Код нижче більше ніколи не виконається.
    }

    // ---------------------------------------------------------
    // БЛОК 2: ОБРОБКА РЕЗУЛЬТАТУ (якщо переривання спіймало сигнал)
    // ---------------------------------------------------------
    if (eventCaptured && !resultPrinted) {
        // ОБЧИСЛЮЄМО МЕХАНІЧНУ ЗАТРИМКУ: Час фінішу мінус Час старту
        uint32_t duration = reactionTime - triggerTime;
        
        if (relayState) { 
            // Якщо зараз ми тестували УВІМКНЕННЯ
            totalTimeOn += duration; // Додаємо до копилки ON
            Serial.printf("Цикл %d. Час ON:  %lu мкс\n", cycleCount + 1, duration);
        } else {          
            // Якщо зараз ми тестували ВИМКНЕННЯ
            totalTimeOff += duration; // Додаємо до копилки OFF
            Serial.printf("Цикл %d. Час OFF: %lu мкс\n", cycleCount + 1, duration);
            cycleCount++; // Збільшуємо лічильник, бо повний цикл (ON+OFF) закінчився
        }
        resultPrinted = true; // Ставимо галочку, що ми вже обробили цей результат
    }

    // ---------------------------------------------------------
    // БЛОК 3: НЕБЛОКУЮЧИЙ МЕТРОНОМ (Перемикач реле)
    // ---------------------------------------------------------
    uint32_t currentMillis = millis(); // Дізнаємося поточний час у мілісекундах
    
    // Перевіряємо, чи пройшло 500 мілісекунд з минулого разу
    if (currentMillis - lastToggleTime >= TOGGLE_INTERVAL) {
        lastToggleTime = currentMillis; // Оновлюємо таймер
        
        relayState = !relayState; // Змінюємо цільовий стан реле на протилежний
        
        eventCaptured = false;    // ВІДКРИВАЄМО ЗАМОК переривання (щоб воно могло ловити новий рух)
        resultPrinted = false;    // Скидаємо прапорець виводу у консоль
        
        // ================= САМА ВАЖЛИВА МИТЬ =================
        triggerTime = micros();   // СТАРТ СЕКУНДОМІРА! Фіксуємо поточну мікросекунду
        
        // Одразу ж після старту секундоміра даємо фізичну команду на зміну напруги:
        digitalWrite(RELAY_CTRL_PIN, relayState ? HIGH : LOW); 
        // =====================================================
    }
}